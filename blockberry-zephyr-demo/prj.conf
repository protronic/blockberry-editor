## CMakeLists.txt
```
cmake_minimum_required(VERSION 3.20.0)

find_package(Zephyr REQUIRED HINTS $ENV{ZEPHYR_BASE})
project(blockberry_zephyr_demo C)

find_package(Python3 REQUIRED COMPONENTS Interpreter)

set(BERRY_DIR "${CMAKE_CURRENT_SOURCE_DIR}/../modules/lib/berry"
    CACHE PATH "Path to the Berry interpreter source")
if(NOT EXISTS "${BERRY_DIR}/src/berry.h")
  message(FATAL_ERROR
    "Berry source missing at ${BERRY_DIR}. Run 'west update' from the workspace root.")
endif()

file(GLOB BERRY_CORE_SOURCES CONFIGURE_DEPENDS "${BERRY_DIR}/src/*.c")
set(BERRY_GENERATED_HEADER "${BERRY_DIR}/generate/be_const_strtab.h")

add_custom_command(
  OUTPUT "${BERRY_GENERATED_HEADER}"
  COMMAND "${CMAKE_COMMAND}" -E make_directory "${BERRY_DIR}/generate"
  COMMAND
    "${Python3_EXECUTABLE}" "${BERRY_DIR}/tools/coc/coc"
    -o "${BERRY_DIR}/generate"
    "${BERRY_DIR}/src" "${BERRY_DIR}/default"
    -c "${CMAKE_CURRENT_SOURCE_DIR}/include/berry_conf.h"
  DEPENDS
    ${BERRY_CORE_SOURCES}
    "${BERRY_DIR}/default/be_modtab.c"
    "${CMAKE_CURRENT_SOURCE_DIR}/include/berry_conf.h"
  COMMENT "Generating Berry constant string table"
  VERBATIM
)

add_custom_target(berry_generated DEPENDS "${BERRY_GENERATED_HEADER}")
add_dependencies(app berry_generated)

target_sources(app PRIVATE
  src/main.c
  src/berry_repl.c
  src/berry_port.c
  src/repl_transport.c
  "${BERRY_DIR}/default/be_modtab.c"
  ${BERRY_CORE_SOURCES}
)

if(CONFIG_BT)
  target_sources(app PRIVATE src/ble_nus.c)
endif()

target_include_directories(app PRIVATE
  include
  "${BERRY_DIR}/src"
  "${BERRY_DIR}/default"
  "${BERRY_DIR}/generate"
)

target_compile_options(app PRIVATE
  -Wno-unused-parameter
  -Wno-missing-field-initializers
  -Wno-sign-compare
)
```

## Kconfig
```
mainmenu "BlockBerry Zephyr demo"

source "Kconfig.zephyr"

menu "BlockBerry REPL"

config BLOCKBERRY_REPL_LINE_SIZE
	int "Maximum Berry REPL line length"
	default 256
	range 64 1024

config BLOCKBERRY_REPL_QUEUE_DEPTH
	int "Queued REPL lines"
	default 8
	range 2 32

config BLOCKBERRY_REPL_SCRIPT_SIZE
	int "Maximum uploaded Berry script size"
	default 8192
	range 1024 32768
	help
	  Static buffer used by the :begin/:end multi-line upload protocol.

config BLOCKBERRY_NUS_REQUIRE_ENCRYPTION
	bool "Require an encrypted BLE link for NUS writes"
	depends on BT
	default n
	help
	  Protect the RX characteristic with encrypted write permissions.
	  Leave disabled only for local development.

endmenu
```

## west.yml
```
manifest:
  version: "1.2"

  remotes:
    - name: zephyrproject
      url-base: https://github.com/zephyrproject-rtos
    - name: berry-lang
      url-base: https://github.com/berry-lang

  projects:
    - name: zephyr
      remote: zephyrproject
      revision: v4.4.1
      import: true
    - name: berry
      remote: berry-lang
      revision: b5ede66721937533fbf5c286ef44a5111ea30c75
      path: modules/lib/berry

  self:
    path: blockberry-zephyr-demo
```

## prj.conf
```kconfig
CONFIG_CONSOLE=y
CONFIG_PRINTK=y
CONFIG_SERIAL=y
CONFIG_UART_CONSOLE=y
CONFIG_CONSOLE_SUBSYS=y
CONFIG_CONSOLE_GETLINE=y

CONFIG_GPIO=y
CONFIG_REBOOT=y

CONFIG_MAIN_STACK_SIZE=8192
CONFIG_SYSTEM_WORKQUEUE_STACK_SIZE=2048
CONFIG_HEAP_MEM_POOL_SIZE=8192
CONFIG_COMMON_LIBC_MALLOC=y
CONFIG_COMMON_LIBC_MALLOC_ARENA_SIZE=32768

CONFIG_BLOCKBERRY_REPL_LINE_SIZE=256
CONFIG_BLOCKBERRY_REPL_QUEUE_DEPTH=8
CONFIG_BLOCKBERRY_REPL_SCRIPT_SIZE=8192

CONFIG_LOG=y
CONFIG_LOG_MODE_DEFERRED=y
CONFIG_LOG_DEFAULT_LEVEL=3
```

## boards/stm32wba65i_dk1.conf
```kconfig
# STM32WBA65 defines interrupts through index 79 while the inherited default
# in Zephyr 4.4.1 only reserves entries through index 65.
CONFIG_NUM_IRQS=80
```

## boards/stm32wb5mmg.overlay
```dts
/*
 * The STM32WB HCI integration installs a software radio ISR on vector 45.
 * The module DTS otherwise has no enabled peripheral at that IRQ, so reserve
 * it explicitly for Zephyr's automatic NUM_IRQS calculation.
 */

/ {
	radio_irq_reservation {
		compatible = "zephyr,irq-reservation";
		interrupt-parent = <&nvic>;
		interrupts = <45 0>;
		status = "okay";
	};
};
```

## boards/stm32wba65i_dk1.overlay
```dts
/*
 * The STM32WBA Bluetooth controller enables temperature-based RF
 * calibration. Its Kconfig dependency requires the die temperature sensor.
 */

/ {
	aliases {
		die-temp0 = &die_temp;
	};

	/*
	 * The closed WBA6 link-layer library installs HASH_IRQn (66) as its
	 * low-priority software interrupt. Represent it in DT so Zephyr's
	 * automatic NUM_IRQS calculation reserves that vector.
	 */
	radio_irq_reservation {
		compatible = "zephyr,irq-reservation";
		interrupt-parent = <&nvic>;
		interrupts = <66 0>;
		status = "okay";
	};
};

&die_temp {
	status = "okay";
};
```

## dts/bindings/misc/zephyr,irq-reservation.yaml
```yaml
description: Interrupt reservation used by a vendor radio library

compatible: "zephyr,irq-reservation"

include: base.yaml

properties:
  interrupts:
    required: true
```

## src/main.c
```c
#include <errno.h>
#include <stdbool.h>
#include <string.h>

#include <zephyr/kernel.h>
#include <zephyr/logging/log.h>

#include "berry_repl.h"
#include "repl_transport.h"

LOG_MODULE_REGISTER(blockberry_demo, LOG_LEVEL_INF);

int main(void)
{
	static const char banner[] =
		"\nBlockBerry Zephyr REPL\n"
		"Try: 1 + 2, millis(), led(true), button()\n"
		"Multi-line upload: :begin ... :end\n";
	static const char script_ready[] = "[script] receiving\n";
	static const char script_aborted[] = "[script] aborted\n";
	static const char script_too_large[] = "[script] too large; aborted\n";
	static char script[CONFIG_BLOCKBERRY_REPL_SCRIPT_SIZE];
	char line[CONFIG_BLOCKBERRY_REPL_LINE_SIZE];
	size_t script_length = 0;
	bool collecting_script = false;
	int err;

	err = bb_transport_init();
	if (err != 0) {
		LOG_ERR("REPL transport initialization failed: %d", err);
		return err;
	}

#if defined(CONFIG_BT)
	err = bb_ble_nus_init();
	if (err != 0) {
		LOG_ERR("BLE NUS initialization failed: %d", err);
		return err;
	}
#endif

	err = bb_repl_init();
	if (err != 0) {
		LOG_ERR("Berry VM initialization failed: %d", err);
		return err;
	}

	bb_transport_write(banner, sizeof(banner) - 1);
	bb_transport_prompt();

	for (;;) {
		err = bb_transport_receive(line, sizeof(line));
		if (err > 0) {
			if (!collecting_script && strcmp(line, ":begin") == 0) {
				collecting_script = true;
				script_length = 0;
				bb_transport_write(script_ready, sizeof(script_ready) - 1);
				continue;
			}

			if (collecting_script && strcmp(line, ":abort") == 0) {
				collecting_script = false;
				script_length = 0;
				bb_transport_write(script_aborted, sizeof(script_aborted) - 1);
			} else if (collecting_script && strcmp(line, ":end") == 0) {
				collecting_script = false;
				if (script_length > 0) {
					(void)bb_repl_eval(script, script_length);
				}
				script_length = 0;
			} else if (collecting_script) {
				size_t line_length = (size_t)err;

				if (script_length + line_length + 1 >= sizeof(script)) {
					collecting_script = false;
					script_length = 0;
					bb_transport_write(script_too_large,
							   sizeof(script_too_large) - 1);
				} else {
					memcpy(script + script_length, line, line_length);
					script_length += line_length;
					script[script_length++] = '\n';
					continue;
				}
			} else {
				(void)bb_repl_eval(line, (size_t)err);
			}
		} else if (err != -EINTR) {
			LOG_WRN("REPL receive failed: %d", err);
		}
		bb_transport_prompt();
	}

	return 0;
}
```

## include/berry_conf.h
```c
#ifndef BLOCKBERRY_BERRY_CONF_H
#define BLOCKBERRY_BERRY_CONF_H

#include <assert.h>

#define BE_DEBUG                         0
#define BE_INTGER_TYPE                   2
#define BE_USE_SINGLE_FLOAT              1
#define BE_USE_PRECOMPILED_OBJECT        1
#define BE_DEBUG_RUNTIME_INFO            1
#define BE_DEBUG_VAR_INFO                0
#define BE_USE_PERF_COUNTERS             0
#define BE_VM_OBSERVABILITY_SAMPLING     16
#define BE_STACK_TOTAL_MAX               512
#define BE_STACK_FREE_MIN                8
#define BE_STACK_START                   32
#define BE_CONST_SEARCH_SIZE             24
#define BE_USE_STR_HASH_CACHE            0

#define BE_USE_FILE_SYSTEM               0
#define BE_USE_SCRIPT_COMPILER           1
#define BE_USE_BYTECODE_SAVER            0
#define BE_USE_BYTECODE_LOADER           0
#define BE_USE_SHARED_LIB                0
#define BE_USE_OVERLOAD_HASH             0
#define BE_USE_DEBUG_HOOK                0
#define BE_USE_DEBUG_GC                  0
#define BE_USE_DEBUG_STACK               0

#define BE_USE_STRING_MODULE             1
#define BE_USE_JSON_MODULE               1
#define BE_USE_MATH_MODULE               0
#define BE_USE_TIME_MODULE               0
#define BE_USE_OS_MODULE                 0
#define BE_USE_GLOBAL_MODULE             1
#define BE_USE_SYS_MODULE                0
#define BE_USE_DEBUG_MODULE              0
#define BE_USE_GC_MODULE                 1
#define BE_USE_SOLIDIFY_MODULE           0
#define BE_USE_INTROSPECT_MODULE         0
#define BE_USE_STRICT_MODULE             0

#define be_assert(expr)                  assert(expr)

#endif
```

## include/berry_repl.h
```c
#ifndef BLOCKBERRY_BERRY_REPL_H
#define BLOCKBERRY_BERRY_REPL_H

#include <stddef.h>

struct bvm;

int bb_repl_init(void);
int bb_repl_eval(const char *source, size_t length);
struct bvm *bb_repl_vm(void);

#endif
```

## include/repl_transport.h
```c
#ifndef BLOCKBERRY_REPL_TRANSPORT_H
#define BLOCKBERRY_REPL_TRANSPORT_H

#include <stddef.h>
#include <stdint.h>

int bb_transport_init(void);
int bb_transport_submit(const uint8_t *data, size_t length);
int bb_transport_receive(char *buffer, size_t capacity);
void bb_transport_write(const char *data, size_t length);
void bb_transport_prompt(void);

#if defined(CONFIG_BT)
int bb_ble_nus_init(void);
void bb_ble_nus_write(const uint8_t *data, size_t length);
#endif

#endif
```

## src/berry_port.c
```c
#include "berry.h"
#include "be_sys.h"
#include "repl_transport.h"

#include <errno.h>
#include <stddef.h>

void be_writebuffer(const char *buffer, size_t length)
{
	bb_transport_write(buffer, length);
}

char *be_readstring(char *buffer, size_t size)
{
	(void)buffer;
	(void)size;
	return NULL;
}

void *be_fopen(const char *filename, const char *modes)
{
	(void)filename;
	(void)modes;
	return NULL;
}

int be_fclose(void *file)
{
	(void)file;
	return -ENOTSUP;
}

size_t be_fwrite(void *file, const void *buffer, size_t length)
{
	(void)file;
	bb_transport_write(buffer, length);
	return length;
}

size_t be_fread(void *file, void *buffer, size_t length)
{
	(void)file;
	(void)buffer;
	(void)length;
	return 0;
}

char *be_fgets(void *file, void *buffer, int size)
{
	(void)file;
	(void)buffer;
	(void)size;
	return NULL;
}

int be_fseek(void *file, long offset)
{
	(void)file;
	(void)offset;
	return -ENOTSUP;
}

long be_ftell(void *file)
{
	(void)file;
	return -1;
}

long be_fflush(void *file)
{
	(void)file;
	return 0;
}

size_t be_fsize(void *file)
{
	(void)file;
	return 0;
}

int be_isdir(const char *path)
{
	(void)path;
	return 0;
}

int be_isfile(const char *path)
{
	(void)path;
	return 0;
}

int be_isexist(const char *path)
{
	(void)path;
	return 0;
}

char *be_getcwd(char *buffer, size_t size)
{
	(void)buffer;
	(void)size;
	return NULL;
}

int be_chdir(const char *path)
{
	(void)path;
	return -ENOTSUP;
}

int be_mkdir(const char *path)
{
	(void)path;
	return -ENOTSUP;
}

int be_unlink(const char *path)
{
	(void)path;
	return -ENOTSUP;
}

int be_dirfirst(bdirinfo *info, const char *path)
{
	(void)info;
	(void)path;
	return -ENOTSUP;
}

int be_dirnext(bdirinfo *info)
{
	(void)info;
	return 1;
}

int be_dirclose(bdirinfo *info)
{
	(void)info;
	return -ENOTSUP;
}
```

## src/berry_repl.c
```c
#include "berry_repl.h"

#include <errno.h>
#include <stdbool.h>
#include <stdio.h>
#include <string.h>

#include <zephyr/drivers/gpio.h>
#include <zephyr/kernel.h>

#include "berry.h"

static bvm *repl_vm;

static const struct gpio_dt_spec led =
	GPIO_DT_SPEC_GET_OR(DT_ALIAS(led0), gpios, { 0 });
static const struct gpio_dt_spec button =
	GPIO_DT_SPEC_GET_OR(DT_ALIAS(sw0), gpios, { 0 });

static int native_millis(bvm *vm)
{
	be_pushint(vm, (bint)k_uptime_get());
	be_return(vm);
}

static int native_led(bvm *vm)
{
	if (led.port == NULL || !device_is_ready(led.port)) {
		be_raise(vm, "io_error", "led0 alias is not available");
	}
	if (!be_isbool(vm, 1) && !be_isint(vm, 1)) {
		be_raise(vm, "type_error", "led(value) expects bool or int");
	}

	gpio_pin_set_dt(&led, be_tobool(vm, 1));
	be_return_nil(vm);
}

static int native_button(bvm *vm)
{
	int value;

	if (button.port == NULL || !device_is_ready(button.port)) {
		be_raise(vm, "io_error", "sw0 alias is not available");
	}

	value = gpio_pin_get_dt(&button);
	if (value < 0) {
		be_raise(vm, "io_error", "cannot read sw0");
	}
	be_pushbool(vm, value != 0);
	be_return(vm);
}

int bb_repl_init(void)
{
	if (led.port != NULL && device_is_ready(led.port)) {
		(void)gpio_pin_configure_dt(&led, GPIO_OUTPUT_INACTIVE);
	}
	if (button.port != NULL && device_is_ready(button.port)) {
		(void)gpio_pin_configure_dt(&button, GPIO_INPUT);
	}

	repl_vm = be_vm_new();
	if (repl_vm == NULL) {
		return -ENOMEM;
	}

	be_regfunc(repl_vm, "millis", native_millis);
	be_regfunc(repl_vm, "led", native_led);
	be_regfunc(repl_vm, "button", native_button);
	return 0;
}

int bb_repl_eval(const char *source, size_t length)
{
	char expression[CONFIG_BLOCKBERRY_REPL_LINE_SIZE + 16];
	int result;
	bool try_expression;

	if (repl_vm == NULL || source == NULL || length == 0) {
		return -EINVAL;
	}
	if (length >= CONFIG_BLOCKBERRY_REPL_SCRIPT_SIZE) {
		return -EMSGSIZE;
	}

	try_expression = length < CONFIG_BLOCKBERRY_REPL_LINE_SIZE &&
			 memchr(source, '\n', length) == NULL;
	if (try_expression) {
		snprintf(expression, sizeof(expression), "return (%.*s)",
			 (int)length, source);
		result = be_loadbuffer(repl_vm, "repl", expression,
				       strlen(expression));

		if (be_getexcept(repl_vm, result) == BE_SYNTAX_ERROR) {
			be_pop(repl_vm, 2);
			result = be_loadbuffer(repl_vm, "repl", source, length);
		}
	} else {
		result = be_loadbuffer(repl_vm, "script", source, length);
	}

	if (result != BE_OK) {
		be_dumpexcept(repl_vm);
		be_pop(repl_vm, 2);
		return -EINVAL;
	}

	result = be_pcall(repl_vm, 0);
	if (result == BE_OK) {
		if (!be_isnil(repl_vm, -1)) {
			be_dumpvalue(repl_vm, -1);
			be_writenewline();
		}
		be_pop(repl_vm, 1);
		return 0;
	}

	if (result == BE_EXCEPTION) {
		be_dumpexcept(repl_vm);
		be_pop(repl_vm, 1);
		return -EFAULT;
	}

	return result == BE_MALLOC_FAIL ? -ENOMEM : -EIO;
}

bvm *bb_repl_vm(void)
{
	return repl_vm;
}
```

## src/ble_nus.c
```c
#include "repl_transport.h"

#include <errno.h>
#include <string.h>

#include <zephyr/bluetooth/bluetooth.h>
#include <zephyr/bluetooth/conn.h>
#include <zephyr/bluetooth/gatt.h>
#include <zephyr/bluetooth/uuid.h>
#include <zephyr/kernel.h>
#include <zephyr/logging/log.h>

LOG_MODULE_REGISTER(bb_nus, LOG_LEVEL_INF);

#define BT_UUID_NUS_SERVICE_VAL \
	BT_UUID_128_ENCODE(0x6e400001, 0xb5a3, 0xf393, 0xe0a9, 0xe50e24dcca9e)
#define BT_UUID_NUS_RX_VAL \
	BT_UUID_128_ENCODE(0x6e400002, 0xb5a3, 0xf393, 0xe0a9, 0xe50e24dcca9e)
#define BT_UUID_NUS_TX_VAL \
	BT_UUID_128_ENCODE(0x6e400003, 0xb5a3, 0xf393, 0xe0a9, 0xe50e24dcca9e)

#define BT_UUID_NUS_SERVICE BT_UUID_DECLARE_128(BT_UUID_NUS_SERVICE_VAL)
#define BT_UUID_NUS_RX      BT_UUID_DECLARE_128(BT_UUID_NUS_RX_VAL)
#define BT_UUID_NUS_TX      BT_UUID_DECLARE_128(BT_UUID_NUS_TX_VAL)

#if defined(CONFIG_BLOCKBERRY_NUS_REQUIRE_ENCRYPTION)
#define NUS_RX_PERMISSIONS BT_GATT_PERM_WRITE_ENCRYPT
#else
#define NUS_RX_PERMISSIONS BT_GATT_PERM_WRITE
#endif

static struct bt_conn *active_connection;
static bool notifications_enabled;
static char rx_line[CONFIG_BLOCKBERRY_REPL_LINE_SIZE];
static size_t rx_length;
K_MUTEX_DEFINE(nus_mutex);

static void ccc_changed(const struct bt_gatt_attr *attr, uint16_t value)
{
	ARG_UNUSED(attr);
	notifications_enabled = (value == BT_GATT_CCC_NOTIFY);
}

static ssize_t rx_written(struct bt_conn *conn, const struct bt_gatt_attr *attr,
			  const void *buffer, uint16_t length, uint16_t offset,
			  uint8_t flags)
{
	const uint8_t *bytes = buffer;

	ARG_UNUSED(conn);
	ARG_UNUSED(attr);
	ARG_UNUSED(flags);

	if (offset != 0U) {
		return BT_GATT_ERR(BT_ATT_ERR_INVALID_OFFSET);
	}

	k_mutex_lock(&nus_mutex, K_FOREVER);
	for (uint16_t index = 0; index < length; ++index) {
		uint8_t byte = bytes[index];

		if (byte == '\r' || byte == '\n') {
			if (rx_length > 0U) {
				int err = bb_transport_submit((const uint8_t *)rx_line, rx_length);

				if (err != 0) {
					LOG_WRN("REPL queue rejected NUS line: %d", err);
				}
				rx_length = 0U;
			}
			continue;
		}

		if (rx_length + 1U >= sizeof(rx_line)) {
			LOG_WRN("NUS REPL line too long; dropping it");
			rx_length = 0U;
			continue;
		}
		rx_line[rx_length++] = (char)byte;
	}
	k_mutex_unlock(&nus_mutex);

	return length;
}

BT_GATT_SERVICE_DEFINE(nus_service,
	BT_GATT_PRIMARY_SERVICE(BT_UUID_NUS_SERVICE),
	BT_GATT_CHARACTERISTIC(BT_UUID_NUS_TX, BT_GATT_CHRC_NOTIFY,
			       BT_GATT_PERM_NONE, NULL, NULL, NULL),
	BT_GATT_CCC(ccc_changed, BT_GATT_PERM_READ | BT_GATT_PERM_WRITE),
	BT_GATT_CHARACTERISTIC(BT_UUID_NUS_RX,
			       BT_GATT_CHRC_WRITE | BT_GATT_CHRC_WRITE_WITHOUT_RESP,
			       NUS_RX_PERMISSIONS, NULL, rx_written, NULL)
);

static const struct bt_data advertising_data[] = {
	BT_DATA_BYTES(BT_DATA_FLAGS, BT_LE_AD_GENERAL | BT_LE_AD_NO_BREDR),
	BT_DATA(BT_DATA_NAME_COMPLETE, CONFIG_BT_DEVICE_NAME,
		sizeof(CONFIG_BT_DEVICE_NAME) - 1),
};

static const struct bt_data scan_response[] = {
	BT_DATA_BYTES(BT_DATA_UUID128_ALL, BT_UUID_NUS_SERVICE_VAL),
};

static void connected(struct bt_conn *conn, uint8_t error)
{
	if (error != 0U) {
		LOG_WRN("BLE connection failed: 0x%02x", error);
		return;
	}

	k_mutex_lock(&nus_mutex, K_FOREVER);
	if (active_connection != NULL) {
		bt_conn_unref(active_connection);
	}
	active_connection = bt_conn_ref(conn);
	k_mutex_unlock(&nus_mutex);

	LOG_INF("NUS client connected");
}

static void disconnected(struct bt_conn *conn, uint8_t reason)
{
	k_mutex_lock(&nus_mutex, K_FOREVER);
	if (active_connection == conn) {
		bt_conn_unref(active_connection);
		active_connection = NULL;
		notifications_enabled = false;
		rx_length = 0U;
	}
	k_mutex_unlock(&nus_mutex);

	LOG_INF("NUS client disconnected: 0x%02x", reason);
}

BT_CONN_CB_DEFINE(connection_callbacks) = {
	.connected = connected,
	.disconnected = disconnected,
};

int bb_ble_nus_init(void)
{
	int err;

	err = bt_enable(NULL);
	if (err != 0) {
		LOG_ERR("Bluetooth initialization failed: %d", err);
		return err;
	}

	err = bt_le_adv_start(BT_LE_ADV_CONN_FAST_1,
			      advertising_data, ARRAY_SIZE(advertising_data),
			      scan_response, ARRAY_SIZE(scan_response));
	if (err != 0) {
		LOG_ERR("NUS advertising failed: %d", err);
		return err;
	}

	LOG_INF("Advertising '%s' with Nordic UART Service", CONFIG_BT_DEVICE_NAME);
	return 0;
}

void bb_ble_nus_write(const uint8_t *data, size_t length)
{
	struct bt_conn *connection = NULL;
	size_t offset = 0U;

	k_mutex_lock(&nus_mutex, K_FOREVER);
	if (active_connection != NULL && notifications_enabled) {
		connection = bt_conn_ref(active_connection);
	}
	k_mutex_unlock(&nus_mutex);

	if (connection == NULL) {
		return;
	}

	while (offset < length) {
		size_t payload = MIN(length - offset, bt_gatt_get_mtu(connection) - 3U);
		int err = bt_gatt_notify(connection, &nus_service.attrs[2],
					 data + offset, payload);

		if (err != 0) {
			LOG_WRN("NUS notification failed: %d", err);
			break;
		}
		offset += payload;
		k_sleep(K_MSEC(2));
	}

	bt_conn_unref(connection);
}
```

## src/repl_transport.c
```c
#include "repl_transport.h"

#include <errno.h>
#include <string.h>

#include <zephyr/console/console.h>
#include <zephyr/device.h>
#include <zephyr/devicetree.h>
#include <zephyr/drivers/uart.h>
#include <zephyr/kernel.h>

static const struct device *const console_device =
	DEVICE_DT_GET(DT_CHOSEN(zephyr_console));

struct repl_message {
	uint16_t length;
	char data[CONFIG_BLOCKBERRY_REPL_LINE_SIZE];
};

K_MSGQ_DEFINE(repl_queue, sizeof(struct repl_message),
	      CONFIG_BLOCKBERRY_REPL_QUEUE_DEPTH, sizeof(void *));

K_THREAD_STACK_DEFINE(console_stack, 1024);
static struct k_thread console_thread;

static void console_rx(void *unused1, void *unused2, void *unused3)
{
	ARG_UNUSED(unused1);
	ARG_UNUSED(unused2);
	ARG_UNUSED(unused3);

	console_getline_init();

	for (;;) {
		char *line = console_getline();

		if (line != NULL) {
			(void)bb_transport_submit((const uint8_t *)line, strlen(line));
		}
	}
}

int bb_transport_init(void)
{
	k_thread_create(&console_thread, console_stack,
			K_THREAD_STACK_SIZEOF(console_stack), console_rx,
			NULL, NULL, NULL, 8, 0, K_NO_WAIT);
	k_thread_name_set(&console_thread, "bb_console_rx");
	return 0;
}

int bb_transport_submit(const uint8_t *data, size_t length)
{
	struct repl_message message = { 0 };

	if (data == NULL || length == 0) {
		return -EINVAL;
	}
	if (length >= sizeof(message.data)) {
		return -EMSGSIZE;
	}

	memcpy(message.data, data, length);
	message.data[length] = '\0';
	message.length = (uint16_t)length;

	return k_msgq_put(&repl_queue, &message, K_NO_WAIT);
}

int bb_transport_receive(char *buffer, size_t capacity)
{
	struct repl_message message;
	int err;

	if (buffer == NULL || capacity == 0) {
		return -EINVAL;
	}

	err = k_msgq_get(&repl_queue, &message, K_FOREVER);
	if (err != 0) {
		return err;
	}
	if ((size_t)message.length + 1 > capacity) {
		return -ENOSPC;
	}

	memcpy(buffer, message.data, message.length + 1);
	return message.length;
}

void bb_transport_write(const char *data, size_t length)
{
	if (data == NULL || length == 0) {
		return;
	}

	if (device_is_ready(console_device)) {
		for (size_t index = 0; index < length; ++index) {
			uart_poll_out(console_device, data[index]);
		}
	}

#if defined(CONFIG_BT)
	bb_ble_nus_write((const uint8_t *)data, length);
#endif
}

void bb_transport_prompt(void)
{
	bb_transport_write("> ", 2);
}
```
